## config/west.yml
```yaml
manifest:
  remotes:
    - name: zmkfirmware
      url-base: https://github.com/zmkfirmware
    - name: badjeff
      url-base: https://github.com/badjeff
    - name: carrefinho
      url-base: https://github.com/carrefinho
    - name: urob
      url-base: https://github.com/urob

  projects:
    - name: zmk
      remote: zmkfirmware
      revision: v0.3
      import: app/west.yml

    - name: zmk-pmw3610-driver
      remote: badjeff
      revision: zmk-0.4

    - name: prospector-zmk-module
      remote: carrefinho
      revision: feat/new-status-screens

    - name: zmk-unicode
      remote: urob
      revision: v0.3

  self:
    path: config
```
